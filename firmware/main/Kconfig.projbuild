## firmware/main/Kconfig.projbuild
```kconfig
menu "Project WiFi Configuration"

    config ESP_WIFI_SSID
        string "WiFi SSID"
        default "your_default_ssid"
        help
            SSID of the WiFi network.

    config ESP_WIFI_PASSWORD
        string "WiFi Password"
        default "your_default_password"
        help
            Password of the WiFi network.

endmenu
```
